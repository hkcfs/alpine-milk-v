// SPDX-License-Identifier: (GPL-2.0 OR MIT)
/*
 * The SG2000 H.264 encoder, a Chips&Media CODA980, and its JPEG unit.
 *
 * Enable with overlays=video-codec in /boot/armbianEnv.txt. The H.264
 * driver loads the vendor firmware from /lib/firmware/coda980.bin. The
 * JPEG unit needs no firmware.
 *
 * The H.265 encoder (WAVE420L) is not in this overlay.
 */
/dts-v1/;
/plugin/;

#include <dt-bindings/clock/sophgo,cv1800.h>
#include <dt-bindings/interrupt-controller/irq.h>
#include <riscv/sophgo/cv18xx-reset.h>

/* The arm64 overlay defines these first, for the GIC */
#ifndef SOC_PERIPHERAL_IRQ
#define SOC_PERIPHERAL_IRQ(nr)	((nr) + 16)
#define SOC_INTC		&plic
#endif

&{/soc} {
	#address-cells = <1>;
	#size-cells = <1>;

	video-codec@b010000 {
		compatible = "sophgo,sg2000-vpu";
		/* The CODA980, and the control block that the codecs share */
		reg = <0x0b010000 0x10000>, <0x0b030000 0x100>;
		reg-names = "bit", "ctrl";
		interrupt-parent = <SOC_INTC>;
		interrupts = <SOC_PERIPHERAL_IRQ(5) IRQ_TYPE_LEVEL_HIGH>;
		interrupt-names = "bit";
		clocks = <&clk CLK_H264C>, <&clk CLK_APB_H264C>,
			 <&clk CLK_AXI_VIDEO_CODEC>, <&clk CLK_VC_SRC0>,
			 <&clk CLK_CFG_REG_VC>;
		clock-names = "per", "ahb", "axi", "src", "cfg";
	};

	jpeg@b000000 {
		compatible = "sophgo,sg2000-jpeg";
		reg = <0x0b000000 0x300>;
		interrupt-parent = <SOC_INTC>;
		interrupts = <SOC_PERIPHERAL_IRQ(4) IRQ_TYPE_LEVEL_HIGH>;
		interrupt-names = "jpeg";
		clocks = <&clk CLK_JPEG>, <&clk CLK_APB_JPEG>,
			 <&clk CLK_AXI_VIDEO_CODEC>, <&clk CLK_VC_SRC0>,
			 <&clk CLK_CFG_REG_VC>;
		clock-names = "per", "ahb", "axi", "src", "cfg";
		resets = <&rst RST_JPEG>;
	};
};
